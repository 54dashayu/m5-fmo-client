## ui-preview-firmware/main/Kconfig.projbuild
```kconfig
menu "FMO board"
choice FMO_BOARD
    prompt "FMO hardware"
    default FMO_BOARD_M5_FIRE
config FMO_BOARD_M5_FIRE
    bool "M5 FIRE (original ESP32)"
    depends on IDF_TARGET_ESP32
config FMO_BOARD_XINGZHI
    bool "Xingzhi Cube 1.54 TFT Wi-Fi"
    depends on IDF_TARGET_ESP32S3
endchoice
endmenu
```

## ui-preview-firmware/sdkconfig.defaults
```kconfig
CONFIG_MQTT_USE_CUSTOM_CONFIG=y
CONFIG_MQTT_POLL_READ_TIMEOUT_MS=20
CONFIG_MQTT_OUTBOX_EXPIRED_TIMEOUT_MS=1500
CONFIG_LWIP_TCP_MSS=1024
CONFIG_LWIP_TCP_SND_BUF_DEFAULT=4096
CONFIG_LWIP_TCP_WND_DEFAULT=4096

CONFIG_LV_INVERT_COLORS=y

# Dim LCD while preserving voice connectivity.
CONFIG_LV_DISP_BACKLIGHT_PWM=y
# CONFIG_SPIRAM is not set
CONFIG_FREERTOS_GENERATE_RUN_TIME_STATS=y
CONFIG_FREERTOS_RUN_TIME_STATS_USING_ESP_TIMER=y
CONFIG_FREERTOS_RUN_TIME_COUNTER_TYPE_U64=y

# CONFIG_ESP_WIFI_IRAM_OPT is not set

# CONFIG_ESP_WIFI_RX_IRAM_OPT is not set

# CONFIG_ESP_WIFI_EXTRA_IRAM_OPT is not set

CONFIG_COMPILER_OPTIMIZATION_SIZE=y
CONFIG_ESPTOOLPY_FLASHSIZE_16MB=y

CONFIG_CUSTOM_DISPLAY_BUFFER_BYTES=1600
CONFIG_ESP_WIFI_STATIC_RX_BUFFER_NUM=4
CONFIG_ESP_WIFI_DYNAMIC_RX_BUFFER_NUM=8
CONFIG_ESP_WIFI_DYNAMIC_TX_BUFFER_NUM=8
CONFIG_LV_MEM_CUSTOM=y

# Runtime metrics require the FreeRTOS task-information API.
CONFIG_FREERTOS_USE_TRACE_FACILITY=y
CONFIG_FREERTOS_USE_STATS_FORMATTING_FUNCTIONS=y
```
